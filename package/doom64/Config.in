## package/doom64/Config.in
```kconfig
config BR2_PACKAGE_DOOM64
	bool "doom64"
	depends on BR2_PACKAGE_SDL2
	depends on BR2_PACKAGE_FLUIDSYNTH
	help
	  Doom64
```

## package/drm_helper/Config.in
```kconfig
config BR2_PACKAGE_DRM_HELPER
	bool "drm_helper"
	depends on BR2_PACKAGE_LIBDRM
	help
	  DRM-KMS helper lib
```

## package/epiphany/Config.in
```kconfig
config BR2_PACKAGE_EPIPHANY
	bool "epiphany"
	depends on BR2_PACKAGE_SDL
	select BR2_PACKAGE_ZLIB
	help
	  EPIPHANY game
```

## package/gpsp/Config.in
```kconfig
comment "gpSP is an open-source Game Boy Advance emulator created by Exophase for the PlayStation Portable"
	depends on BR2_PACKAGE_SDL

menuconfig BR2_PACKAGE_GPSP
	bool "gpsp"
	depends on BR2_PACKAGE_SDL
	depends on BR2_PACKAGE_DRM_HELPER
	help
	  gpSP is an open-source Game Boy Advance emulator created by
	  Exophase for the PlayStation Portable
```

## package/grafx2/Config.in
```kconfig
config BR2_PACKAGE_GRAFX2
	bool "grafx2"
	depends on BR2_PACKAGE_SDL
	select BR2_PACKAGE_SDL_IMAGE
	select BR2_PACKAGE_SDL_TTF
	help
	  GrafX2 - The Ultimate 256-color bitmap paint program
```

## package/lua-newt/Config.in
```kconfig
config BR2_PACKAGE_LUA_NEWT
	bool "lua-newt"
	depends on !BR2_STATIC_LIBS
	depends on BR2_PACKAGE_NEWT
	help
	  Lua C binding for the newt lib.

comment "lua-newt needs a newt"
        depends on !BR2_PACKAGE_NEWT
        depends on BR2_STATIC_LIBS
```

## package/lua-sdl/Config.in
```kconfig
config BR2_PACKAGE_LUA_SDL
	bool "lua-sdl"
	depends on !BR2_STATIC_LIBS
	depends on !BR2_PACKAGE_LUA_5_4
	select BR2_PACKAGE_SDL
	help
	  Lua-SDL is a pure C binding of SDL to Lua 5.1, Lua 5.2,
	  Lua 5.3, and LuaJIT.

comment "lua-sdl needs a toolchain w/ dynamic library, Lua <= 5.3"
	depends on BR2_STATIC_LIBS || BR2_PACKAGE_LUA_5_4
```

## package/mednafen/Config.in
```kconfig
config BR2_PACKAGE_MEDNAFEN
	bool "mednafen"
	depends on BR2_PACKAGE_SDL
	select BR2_PACKAGE_FLAC
	help
	  Mednafen game consoles emul
```

## package/mgba/Config.in
```kconfig
config BR2_PACKAGE_MGBA
	bool "mgba"
	depends on BR2_PACKAGE_SDL
	help
	  MGBA emul
```

## package/mocp/Config.in
```kconfig
config BR2_PACKAGE_MOCP
	bool "mocp"
	select BR2_PACKAGE_BERKELEYDB
	select BR2_PACKAGE_LIBTOOL
	help
	  MOC (music on console) is a console audio player 
	  for Linux/Unix designed to be powerful and easy to use.
```

## package/sdl2_test/Config.in
```kconfig
config BR2_PACKAGE_SDL2_TEST
	bool "sdl2_test"
	depends on BR2_PACKAGE_SDL2
	help
	  SDL2 test
```

## package/sdl_test/Config.in
```kconfig
config BR2_PACKAGE_SDL_TEST
	bool "sdl_test"
	depends on BR2_PACKAGE_SDL
	help
	  SDL test
```

## package/snes9x/Config.in
```kconfig
config BR2_PACKAGE_SNES9X
	bool "snes9x"
	depends on BR2_PACKAGE_SDL
	help
	  SNES emul
```

## package/visualboyadvance/Config.in
```kconfig
config BR2_PACKAGE_VISUALBOYADVANCE
	bool "visualboyadvance"
	depends on BR2_PACKAGE_SDL
	help
	  VBA emul
```
